## config/boards/shields/dp65/Kconfig.defconfig
```kconfig
# Copyright (c) 2026 Umi4Life
# SPDX-License-Identifier: MIT

if SHIELD_DP65_LEFT

config ZMK_KEYBOARD_NAME
    default "DP65"

config ZMK_SPLIT_ROLE_CENTRAL
    default y

endif

if SHIELD_DP65_LEFT || SHIELD_DP65_RIGHT

config ZMK_SPLIT
    default y

if ZMK_DISPLAY

config SPI
    default y

endif # ZMK_DISPLAY

endif
```

## config/boards/shields/dp65/Kconfig.shield
```kconfig
# Copyright (c) 2026 Umi4Life
# SPDX-License-Identifier: MIT

config SHIELD_DP65_LEFT
    def_bool $(shields_list_contains,dp65_left)

config SHIELD_DP65_RIGHT
    def_bool $(shields_list_contains,dp65_right)
```
